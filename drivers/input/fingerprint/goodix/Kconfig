## drivers/input/fingerprint/goodix/Kconfig
```kconfig
config GOODIX_FINGERPRINT
	tristate "generic goodix fingerprint driver"
	depends on INPUT_FINGERPRINT
	help
	    Say Y here to enable goodix fingerprint driver support!
```
